// Night sky: stars and constellation lines on the celestial sphere, seen from inside, turned by hand.
// The stick has no compass and no location, so this is a map of the sphere (RA/Dec, J2000), not the
// sky above you: it starts from an arbitrary direction, with no horizon and no compass marks.
// All data is built in (sky_data.h, generated by scripts/make_sky_data.py). See edu_feature.h.
#include "sky_core.h"

// Same feel as the 3D view. turnsWithGyro is false because the shared turning also spins by itself
// when the hand is still, and a constellation has to stay where you found it.
static const float SKY_TURN_GAIN = 2.0f;
static const float SKY_TURN_SIGN = -1.0f;  // The sky stays put while the stick turns: turn right, stars move left
static const float SKY_STILL_DPS = 3.0f;   // Below this the hand isn't turning: sensor noise
static const float SKY_HINT_SECONDS = 5.0f;
static const float SKY_FIT_HALF_HEIGHT = 50.0f;  // A constellation fits if it stays this many pixels from the middle
static const unsigned long SKY_LOG_MS = 5000;
static const uint16_t SKY_COLOR_HIGHLIGHT = 0xF5A0;  // Citrus #f2b705, as elsewhere
static const uint16_t SKY_COLOR_LINE = 0x3189;
static const uint16_t SKY_COLOR_NAME = 0x8C71;
static const int SKY_LABEL_BOXES = 5;

static int skyHighlight = SKY_NOT_FOUND;  // Constellation index, or SKY_WHOLE_DOME
static bool skyGerman = true;
static float skyHintLeft = 0;
static uint16_t skyPalette[6][6];
static int skyBoxes[SKY_LABEL_BOXES][4];
static int skyBoxCount = 0;

// For the serial log line: how long drawing takes and how much is on screen
static unsigned long skyLogStart = 0;
static uint32_t skyLogFrames = 0;
static uint32_t skyLogBusyUs = 0;
static uint32_t skyLogMaxUs = 0;

static bool skyFetch(const char* query) {
  const int found = skyFindConstellation(query);
  if (found == SKY_NOT_FOUND) {
    Serial.printf("Sky lookup '%s': not on the list\n", query);
    return false;
  }
  Preferences skyPrefs;
  skyPrefs.begin("settings", true);
  skyGerman = skyPrefs.getString("language", "DE") != "EN";
  skyPrefs.end();
  skyHighlight = found;
  // The whole dome starts at Orion only because it's easy to recognise; it has nothing to do with the real direction
  const SkyConstellation& c = SKY_CONSTELLATIONS[found >= 0 ? found : skyFindConstellation("Orion")];
  skyLookAt(c.x, c.y, c.z, modelRotation);
  if (found >= 0) {
    modelZoomStep = skyFitZoom(c.radiusDeg, SKY_FIT_HALF_HEIGHT);
    modelLabel = skyGerman ? c.german : c.latin;
  } else {
    modelZoomStep = 0;
    modelLabel = skyGerman ? "Alle Sternbilder" : "All constellations";
  }
  skyHintLeft = SKY_HINT_SECONDS;
  Serial.printf("Sky lookup '%s': %s, %d stars, %d lines\n", query, modelLabel.c_str(), SKY_STAR_COUNT, SKY_LINE_COUNT);
  return true;
}

static bool skyBegin(M5Canvas& c) {
  (void)c;
  for (uint8_t starClass = 0; starClass < 6; starClass++) {
    for (uint8_t band = 0; band < 6; band++) skyPalette[starClass][band] = skyStarColor565(starClass, band);
  }
  skyLogStart = millis();
  skyLogFrames = skyLogBusyUs = skyLogMaxUs = 0;
  return true;
}

// Follows the hand directly, and only then: lying still, the sky stays where it is
static void skyTurnWithHand(float dt) {
  const float gx = modelGyroDps[0], gy = modelGyroDps[1], gz = modelGyroDps[2];
  if (sqrtf(gx * gx + gy * gy + gz * gz) < SKY_STILL_DPS) return;
  const float k = SKY_TURN_SIGN * SKY_TURN_GAIN * dt * (float)M_PI / 180.0f;
  mat3Rotate(modelRotation, k * gx, k * gy, k * gz);
}

// Draws one constellation's lines. Returns how many it drew.
static int skyDrawLines(M5Canvas& c, int constellation, float focal, float cx, float cy, int bottom, uint16_t color) {
  const SkyConstellation& con = SKY_CONSTELLATIONS[constellation];
  const float unit = 1.0f / 32767.0f;
  int drawn = 0;
  const int end = (con.lineStart + con.lineCount) * 2;
  for (int k = con.lineStart * 2; k < end; k += 2) {
    const SkyStar& a = SKY_STARS[SKY_LINES[k]];
    const SkyStar& b = SKY_STARS[SKY_LINES[k + 1]];
    float pa[3], pb[3];
    rotatePoint(modelRotation, a.x * unit, a.y * unit, a.z * unit, pa);
    rotatePoint(modelRotation, b.x * unit, b.y * unit, b.z * unit, pb);
    if (!skyClipLine(pa, pb)) continue;
    float x0, y0, x1, y1;
    if (!skyProject(pa, focal, cx, cy, x0, y0) || !skyProject(pb, focal, cx, cy, x1, y1)) continue;
    if ((x0 < 0 && x1 < 0) || (x0 >= WIDTH && x1 >= WIDTH) || (y0 < 0 && y1 < 0) || (y0 >= bottom && y1 >= bottom)) continue;
    c.drawLine((int)x0, (int)y0, (int)x1, (int)y1, color);
    drawn++;
  }
  return drawn;
}

// Only what's in front is projected, so the whole table stays cheap. Returns how many it drew.
static int skyDrawStars(M5Canvas& c, float focal, float cx, float cy, int bottom) {
  const float* m = modelRotation.m;
  const float corner = sqrtf(cx * cx + cy * cy) + 4.0f;
  const float limit = -32767.0f * focal / sqrtf(focal * focal + corner * corner);
  int drawn = 0;
  for (int i = 0; i < SKY_STAR_COUNT; i++) {
    const SkyStar& s = SKY_STARS[i];
    const float depth = m[6] * s.x + m[7] * s.y + m[8] * s.z;
    if (depth > limit) continue;
    const float k = focal / -depth;
    const int x = (int)(cx + (m[0] * s.x + m[1] * s.y + m[2] * s.z) * k);
    const int y = (int)(cy - (m[3] * s.x + m[4] * s.y + m[5] * s.z) * k);
    if (x < -2 || x >= WIDTH + 2 || y < -2 || y >= bottom + 2) continue;
    const uint8_t starClass = skyStarClass(s.mag10);
    const uint8_t radius = skyStarRadius(starClass);
    const uint16_t color = skyPalette[starClass][s.band];
    if (radius == 0) {
      c.drawPixel(x, y, color);
    } else {
      c.fillCircle(x, y, radius, color);
    }
    drawn++;
  }
  return drawn;
}

// Reserves a place for a label. False if it's off the picture or on top of another one.
static bool skyPlaceBox(int x, int y, int w, int h, int bottom) {
  if (x < 0 || y < 0 || x + w > WIDTH || y + h > bottom || skyBoxCount >= SKY_LABEL_BOXES) return false;
  for (int i = 0; i < skyBoxCount; i++) {
    const int* b = skyBoxes[i];
    if (x < b[0] + b[2] && x + w > b[0] && y < b[1] + b[3] && y + h > b[1]) return false;
  }
  int* b = skyBoxes[skyBoxCount++];
  b[0] = x; b[1] = y; b[2] = w; b[3] = h;
  return true;
}

// The constellation's name, big, top left; its main stars with their names; an arrow if it's out of view
static void skyDrawHighlightLabels(M5Canvas& c, float focal, float cx, float cy, int bottom) {
  const SkyConstellation& con = SKY_CONSTELLATIONS[skyHighlight];
  c.setFreeFont(FontManager::getFont12pt());
  c.setTextSize(1);
  c.setTextDatum(textdatum_t::top_left);
  const int nameWidth = c.textWidth(modelLabel) + 6;
  const int nameHeight = c.fontHeight();
  c.fillRect(0, 0, nameWidth, nameHeight + 2, TFT_BLACK);
  c.setTextColor(SKY_COLOR_HIGHLIGHT);
  c.drawString(modelLabel, 3, 1);
  skyPlaceBox(0, 0, nameWidth, nameHeight + 2, bottom);

  c.setFont(&fonts::DejaVu9);
  c.setTextSize(1);
  c.setTextColor(TFT_LIGHTGREY);
  const float unit = 1.0f / 32767.0f;
  for (int i = 0; i < con.mainCount; i++) {
    const SkyStar& s = SKY_STARS[con.mainStar[i]];
    float p[3], sx, sy;
    rotatePoint(modelRotation, s.x * unit, s.y * unit, s.z * unit, p);
    if (!skyProject(p, focal, cx, cy, sx, sy)) continue;
    if (sx < 0 || sx >= WIDTH || sy < 0 || sy >= bottom) continue;
    const int w = c.textWidth(con.mainName[i]);
    const int h = c.fontHeight();
    const int y = (int)sy - h / 2;
    int x = (int)sx + 5;
    if (!skyPlaceBox(x, y, w, h, bottom)) {
      x = (int)sx - 5 - w;
      if (!skyPlaceBox(x, y, w, h, bottom)) continue;
    }
    c.drawString(con.mainName[i], x, y);
  }

  float p[3], sx = 0, sy = 0;
  rotatePoint(modelRotation, con.x * unit, con.y * unit, con.z * unit, p);
  const bool inView = skyProject(p, focal, cx, cy, sx, sy) && sx >= 0 && sx < WIDTH && sy >= 0 && sy < bottom;
  if (!inView) {
    float x, y, ux, uy;
    skyEdgePoint(p[0], -p[1], cx, cy, cx - 9.0f, cy - 9.0f, x, y, ux, uy);
    c.fillTriangle((int)(x + ux * 8), (int)(y + uy * 8), (int)(x - uy * 6), (int)(y + ux * 6), (int)(x + uy * 6),
                   (int)(y - ux * 6), SKY_COLOR_HIGHLIGHT);
  }
}

// Whole dome: the names of the few constellations nearest the middle of the picture
static void skyDrawDomeLabels(M5Canvas& c, float focal, float cx, float cy, int bottom) {
  const float* m = modelRotation.m;
  int best[3] = {-1, -1, -1};
  float bestDepth[3] = {0, 0, 0};
  for (int i = 0; i < SKY_CONSTELLATION_COUNT; i++) {
    const SkyConstellation& con = SKY_CONSTELLATIONS[i];
    float depth = m[6] * con.x + m[7] * con.y + m[8] * con.z;
    int index = i;
    for (int k = 0; k < 3; k++) {
      if (best[k] < 0 || depth < bestDepth[k]) {
        const int keptIndex = best[k];
        const float keptDepth = bestDepth[k];
        best[k] = index;
        bestDepth[k] = depth;
        index = keptIndex;
        depth = keptDepth;
        if (index < 0) break;
      }
    }
  }
  c.setFreeFont(FontManager::getFont12pt());
  c.setTextSize(1);
  c.setTextDatum(textdatum_t::top_left);
  c.setTextColor(SKY_COLOR_NAME);
  const float unit = 1.0f / 32767.0f;
  for (int k = 0; k < 3; k++) {
    if (best[k] < 0) continue;
    const SkyConstellation& con = SKY_CONSTELLATIONS[best[k]];
    float p[3], sx, sy;
    rotatePoint(modelRotation, con.x * unit, con.y * unit, con.z * unit, p);
    if (!skyProject(p, focal, cx, cy, sx, sy)) continue;
    const char* name = skyGerman ? con.german : con.latin;
    const int w = c.textWidth(name);
    const int h = c.fontHeight();
    const int x = (int)sx - w / 2, y = (int)sy - h / 2;
    if (skyPlaceBox(x, y, w, h, bottom)) c.drawString(name, x, y);
  }
}

// For the first seconds: how to use it, and that this isn't the sky above you
static void skyDrawHint(M5Canvas& c, int bottom) {
  const int height = 30;
  c.fillRect(0, bottom - height, WIDTH, height, TFT_BLACK);
  c.setFreeFont(FontManager::getFont12pt());
  c.setTextSize(1);
  c.setTextDatum(textdatum_t::top_left);
  c.setTextColor(TFT_WHITE);
  c.drawString(skyGerman ? "Sternkarte: dreh mich!" : "Star map: turn me!", 3, bottom - height);
  c.setFont(&fonts::DejaVu9);
  c.setTextSize(1);
  c.setTextColor(TFT_LIGHTGREY);
  c.drawString(skyGerman ? "Zeigt nicht zum echten Himmel" : "Does not point at the real sky", 3, bottom - 11);
}

// One line every few seconds while the view is open: open it with serial "model sky:all" to measure.
// fps is capped at 25 by the view; draw is this function alone, without sending the picture to the screen.
static void skyLogTiming(uint32_t busyUs, int stars, int lines) {
  skyLogFrames++;
  skyLogBusyUs += busyUs;
  if (busyUs > skyLogMaxUs) skyLogMaxUs = busyUs;
  const unsigned long elapsed = millis() - skyLogStart;
  if (elapsed < SKY_LOG_MS) return;
  Serial.printf("skybench fps=%.1f drawAvgUs=%lu drawMaxUs=%lu stars=%d/%d lines=%d/%d zoom=%d sprite=%s freeHeap=%u\n",
                skyLogFrames * 1000.0f / elapsed, (unsigned long)(skyLogBusyUs / skyLogFrames), (unsigned long)skyLogMaxUs,
                stars, SKY_STAR_COUNT, lines, SKY_LINE_COUNT, modelZoomStep, modelViewSpriteInPsram() ? "psram" : "internal",
                (unsigned)ESP.getFreeHeap());
  skyLogStart = millis();
  skyLogFrames = skyLogBusyUs = skyLogMaxUs = 0;
}

static void skyFrame(M5Canvas& c, float dt) {
  const uint32_t started = micros();
  skyTurnWithHand(dt);
  c.fillSprite(TFT_BLACK);
  const int bottom = HEIGHT - EDU_FOOTER_HEIGHT;
  const float cx = WIDTH / 2.0f, cy = bottom / 2.0f;
  const float focal = SKY_FOCAL[modelZoomStep < 3 ? modelZoomStep : 0];

  int lines = 0;
  for (int i = 0; i < SKY_CONSTELLATION_COUNT; i++) {
    if (i != skyHighlight) lines += skyDrawLines(c, i, focal, cx, cy, bottom, SKY_COLOR_LINE);
  }
  if (skyHighlight >= 0) lines += skyDrawLines(c, skyHighlight, focal, cx, cy, bottom, SKY_COLOR_HIGHLIGHT);
  const int stars = skyDrawStars(c, focal, cx, cy, bottom);

  skyBoxCount = 0;
  if (skyHintLeft > 0) {
    skyHintLeft -= dt;
    skyPlaceBox(0, bottom - 30, WIDTH, 30, bottom);
    skyDrawHint(c, bottom);
  }
  if (skyHighlight >= 0) {
    skyDrawHighlightLabels(c, focal, cx, cy, bottom);
  } else {
    skyDrawDomeLabels(c, focal, cx, cy, bottom);
  }
  eduDrawFooter(c, 0);
  skyLogTiming(micros() - started, stars, lines);
}

const EduFeature FEATURE_SKY = {
    "sky", "Yale BSC, IAU",
    "STERNKARTE: Bei Fragen nach Sternbildern oder den Sternen am Nachthimmel, oder wenn jemand ausdruecklich eine "
    "Sternkarte will, setze 'model' auf 'sky:<Name des Sternbilds auf Englisch oder Latein>' (z.B. 'Wo ist Orion?' "
    "ergibt 'sky:Orion', 'Wie sieht der Grosse Baer aus?' ergibt 'sky:Ursa Major'). Fuer den ganzen Himmel oder "
    "mehrere Sternbilder: 'sky:all'. Nicht fuer einzelne Sterne, Planeten, Mond, Sonne oder Galaxien: "
    "dort bleibt model leer. Die Karte zeigt nicht den Himmel am Standort des Nutzers. Gib nie selbst Sterndaten an.",
    false,  // Turns with the hand, in skyTurnWithHand: the shared turning would also spin by itself
    skyFetch, nullptr, skyBegin, skyFrame, nullptr, nullptr, nullptr, nullptr};
